## general/package/qlink/Config.in
```kconfig
config BR2_PACKAGE_QLINK
	bool "qlink"
	depends on BR2_TOOLCHAIN_HAS_THREADS
	help
	  QLink Adaptive Link Manager for UAV video transmission.
	  Monitors telemetry and dynamically adjusts WFB-ng/Majestic settings.

	  https://github.com/Vulpisfoglia-dev/QLink

comment "qlink needs a toolchain w/ threads"
	depends on !BR2_TOOLCHAIN_HAS_THREADS
```
